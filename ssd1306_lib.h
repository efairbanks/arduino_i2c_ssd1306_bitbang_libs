#include "i2c_lib.h"

#define SSD1306_I2C_ADDRESS                           0x3C
#define SSD1306_LCDWIDTH                              128
#define SSD1306_LCDHEIGHT                             64
#define SSD1306_SETCONTRAST                           0x81
#define SSD1306_DISPLAYALLON_RESUME                   0xA4
#define SSD1306_DISPLAYALLON                          0xA5
#define SSD1306_NORMALDISPLAY                         0xA6
#define SSD1306_INVERTDISPLAY                         0xA7
#define SSD1306_DISPLAYOFF                            0xAE
#define SSD1306_DISPLAYON                             0xAF
#define SSD1306_SETDISPLAYOFFSET                      0xD3
#define SSD1306_SETCOMPINS                            0xDA
#define SSD1306_SETVCOMDETECT                         0xDB
#define SSD1306_SETDISPLAYCLOCKDIV                    0xD5
#define SSD1306_SETPRECHARGE                          0xD9
#define SSD1306_SETMULTIPLEX                          0xA8
#define SSD1306_SETLOWCOLUMN                          0x00
#define SSD1306_SETHIGHCOLUMN                         0x10
#define SSD1306_SETSTARTLINE                          0x40
#define SSD1306_MEMORYMODE                            0x20
#define SSD1306_COLUMNADDR                            0x21
#define SSD1306_PAGEADDR                              0x22
#define SSD1306_COMSCANINC                            0xC0
#define SSD1306_COMSCANDEC                            0xC8
#define SSD1306_SEGREMAP                              0xA0
#define SSD1306_CHARGEPUMP                            0x8D
#define SSD1306_EXTERNALVCC                           0x1
#define SSD1306_SWITCHCAPVCC                          0x2
#define SSD1306_ACTIVATE_SCROLL                       0x2F
#define SSD1306_DEACTIVATE_SCROLL                     0x2E
#define SSD1306_SET_VERTICAL_SCROLL_AREA              0xA3
#define SSD1306_RIGHT_HORIZONTAL_SCROLL               0x26
#define SSD1306_LEFT_HORIZONTAL_SCROLL                0x27
#define SSD1306_VERTICAL_AND_RIGHT_HORIZONTAL_SCROLL  0x29
#define SSD1306_VERTICAL_AND_LEFT_HORIZONTAL_SCROLL   0x2A

static uint8_t ssd1306_buffer[SSD1306_LCDHEIGHT * SSD1306_LCDWIDTH / 8] = {
0x00, 0x00, 0x00, 0x00, 0x00, 0x00, 0x00, 0x00, 0x00, 0x00, 0x00, 0x00, 0x00, 0x00, 0x00, 0x00,
0x00, 0x00, 0x00, 0x00, 0x00, 0x00, 0x00, 0x00, 0x00, 0x00, 0x00, 0x00, 0x00, 0x00, 0x00, 0x00,
0x00, 0x00, 0x00, 0x00, 0x00, 0x00, 0x00, 0x00, 0x00, 0x00, 0x00, 0x00, 0x00, 0x00, 0x00, 0x00,
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0x80, 0x80, 0x00, 0x80, 0x80, 0x00, 0x00, 0x00, 0x00, 0x80, 0x80, 0x80, 0x80, 0x80, 0x00, 0xFF,
#if (SSD1306_LCDHEIGHT * SSD1306_LCDWIDTH > 96*16)
0xFF, 0xFF, 0x00, 0x00, 0x00, 0x00, 0x80, 0x80, 0x80, 0x80, 0x00, 0x00, 0x80, 0x80, 0x00, 0x00,
0x80, 0xFF, 0xFF, 0x80, 0x80, 0x00, 0x80, 0x80, 0x00, 0x80, 0x80, 0x80, 0x80, 0x00, 0x80, 0x80,
0x00, 0x00, 0x00, 0x00, 0x00, 0x80, 0x80, 0x00, 0x00, 0x8C, 0x8E, 0x84, 0x00, 0x00, 0x80, 0xF8,
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0x03, 0x01, 0x00, 0x00, 0x00, 0x00, 0x00, 0x00, 0x00, 0x00, 0x00, 0x00, 0x00, 0x00, 0x00, 0x00,
#if (SSD1306_LCDHEIGHT == 64)
0x00, 0x00, 0x00, 0x80, 0xC0, 0xE0, 0xF0, 0xF9, 0xFF, 0xFF, 0xFF, 0xFF, 0xFF, 0x3F, 0x1F, 0x0F,
0x87, 0xC7, 0xF7, 0xFF, 0xFF, 0x1F, 0x1F, 0x3D, 0xFC, 0xF8, 0xF8, 0xF8, 0xF8, 0x7C, 0x7D, 0xFF,
0xFF, 0xFF, 0xFF, 0xFF, 0xFF, 0xFF, 0xFF, 0x7F, 0x3F, 0x0F, 0x07, 0x00, 0x30, 0x30, 0x00, 0x00,
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0x00, 0x00, 0x00, 0x00, 0x00, 0x00, 0x00, 0x00, 0x00, 0x00, 0x00, 0x00, 0x00, 0x00, 0x00, 0x00
#endif
#endif
};

static uint8_t ssd1306_init[] = {
  SSD1306_DISPLAYOFF,
  SSD1306_SETDISPLAYCLOCKDIV,
  0x80,
  SSD1306_SETMULTIPLEX,
  SSD1306_LCDHEIGHT - 1,
  SSD1306_SETDISPLAYOFFSET,
  0x00,
  SSD1306_SETSTARTLINE | 0x0,
  SSD1306_CHARGEPUMP,
  0x14,
  SSD1306_MEMORYMODE,
  0x00,
  SSD1306_SEGREMAP | 0x1,
  SSD1306_COMSCANDEC,
  SSD1306_SETCOMPINS,
  #if (SSD1306_LCDHEIGHT == 64)
  0x12, // 0x02 for 32 height, 0x12 for 64
  #else
  0x02,
  #endif
  SSD1306_SETCONTRAST,
  0x8F,
  SSD1306_SETPRECHARGE,
  0xF1,
  SSD1306_SETVCOMDETECT,
  0x40,
  SSD1306_DISPLAYALLON_RESUME,
  SSD1306_NORMALDISPLAY,
  SSD1306_DEACTIVATE_SCROLL,
  SSD1306_DISPLAYON  
};

static uint8_t ssd1306_display[] = {
  SSD1306_COLUMNADDR,
  0,
  SSD1306_LCDWIDTH-1,
  SSD1306_PAGEADDR,
  0,
  #if (SSD1306_LCDHEIGHT == 64)
  7
  #else
  3
  #endif
};

typedef enum SSD1306_Operation {
  SSD1306_IDLE,           // do nothing
  SSD1306_INIT,           // init
  SSD1306_DISPLAY         // dislpay framebuffer
} SSD1306_Operation;

typedef struct SSD1306 {
  I2C_Bus bus;
  SSD1306_Operation operation;
  int busState;
  int state;
} SSD1306;

void SSD1306_Init(SSD1306* screen, int dataPin, int clockPin) {
  I2C_Init(&screen->bus, dataPin, clockPin, SSD1306_I2C_ADDRESS);
  screen->operation = SSD1306_INIT; // bkmk SHOULD BE INIT
  screen->busState = 0;
  screen->state = 0;
}

void SSD1306_Display(SSD1306* screen) {
  screen->operation = SSD1306_DISPLAY;
  screen->busState = 0;
  screen->state = 0;
}

// true if busy
int SSD1306_Loop(SSD1306* screen) {
  int busy = 0;
  switch(screen->operation) {
    case SSD1306_IDLE:
      break;
    case SSD1306_INIT:
      // if done screen init
      if(screen->state >= sizeof(ssd1306_init)) {
        screen->operation = SSD1306_IDLE;
        screen->busState = 0;
        screen->state = 0;
      // if still initializing screen
      } else {
        busy = 1;
        // perform bus operations till they're done
        if(!I2C_Loop(&screen->bus)) {
          // set up next bus operation
          switch(screen->busState) {
            case 0:
              I2C_Start(&screen->bus);
              break;
            case 1:
              I2C_WriteByte(&screen->bus, 0);
              break;
            case 2:
              I2C_WriteByte(&screen->bus, ssd1306_init[screen->state]);
              break;
            case 3:
              I2C_Stop(&screen->bus);
              screen->state++;
              break;
          }
          screen->busState = (screen->busState+1) % 4;
        }
      }
      break;
    case SSD1306_DISPLAY:
      // if done screen display
      if(screen->state >= sizeof(ssd1306_buffer) + sizeof(ssd1306_display)) {
        screen->operation = SSD1306_IDLE;
        screen->busState = 0;
        screen->state = 0;
      // if still displaying screen
      } else {
        busy = 1;
        // if still running display setup sequence
        if(screen->state < sizeof(ssd1306_display)) {
        // perform bus operations till they're done
          if(!I2C_Loop(&screen->bus)) {
            // set up next bus operation
            switch(screen->busState) {
              case 0:
                I2C_Start(&screen->bus);
                break;
              case 1:
                I2C_WriteByte(&screen->bus, 0);
                break;
              case 2:
                I2C_WriteByte(&screen->bus, ssd1306_display[screen->state]);
                break;
              case 3:
                I2C_Stop(&screen->bus);
                screen->state++;
                break;
            }
            screen->busState = (screen->busState+1) % 4;
          }
          // if writing frame buffer
        } else {
          if(!I2C_Loop(&screen->bus)) {
          int frameBufferIndex = screen->state - sizeof(ssd1306_display);
            // set up next bus operation
            switch(screen->busState) {
              case 0:
                I2C_Start(&screen->bus);
                screen->busState = (screen->busState+1) % 4;
                break;
              case 1:
                I2C_WriteByte(&screen->bus, 0x40);
                screen->busState = (screen->busState+1) % 4;
                break;
              case 2:
                I2C_WriteByte(&screen->bus, ssd1306_buffer[frameBufferIndex]);
                if(frameBufferIndex%16 == 15) {
                  screen->busState = (screen->busState+1) % 4;
                } else {
                  screen->state++;
                }
                break;
              case 3:
                I2C_Stop(&screen->bus);
                screen->busState = (screen->busState+1) % 4;
                screen->state++;
                break;
            }
          }
        }
      }
      break;
  }
  return busy;
}




